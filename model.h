/*
 * model.h — Embedded Logistic Regression Classifier
 * ===================================================
 * Generated by: micromlgen / Eloquent ML (https://eloquentarduino.com)
 * Source model : sklearn.linear_model.LogisticRegression
 *                (penalty=L2, C=0.1, solver=newton-cg)
 * Trained on   : 13-dimensional feature vector
 *                [FSR1, FSR2, FSR3, FSR4, FSR5, FSR6,
 *                 FSR7, FSR8, FSR9, FSR10, FSR11, FSR12, TrunkAngle]
 *
 * Class Mapping
 * -------------
 * The training dataset uses integer labels:
 *   Label 1 = low-risk  posture
 *   Label 2 = high-risk posture
 *
 * Eloquent ML re-indexes classes to zero-based indices in sorted order:
 *   classIdx = 0  ←→  Label 1 (low-risk)
 *   classIdx = 1  ←→  Label 2 (high-risk)
 *
 * Usage in firmware (sketch_smartinsole.ino):
 *   int classIdx = classifier.predict(features);
 *   if (classIdx == 0) { // low-risk  → Green LED          }
 *   else               { // high-risk → Red LED + Buzzer   }
 *
 * Performance (independent test set, k=13 features, as reported in manuscript)
 * -----------------------------------------------------------------------------
 *   Accuracy    : 91.17 %
 *   Sensitivity : 93.75 %   (high-risk recall)
 *   Specificity : 87.83 %   (low-risk  recall)
 *   AUC         : 0.94
 */

#pragma once
#include <cstdarg>

namespace Eloquent {
    namespace ML {
        namespace Port {

            class LogisticRegression {
                public:
                    /**
                     * Predict zero-based class index for a 13-element feature vector.
                     *
                     * @param x  Pointer to float array of length 13:
                     *           x[0]–x[11] = FSR1–FSR12 (averaged over 1-second window)
                     *           x[12]      = TrunkAngle in degrees
                     * @return   0 = low-risk (Label 1), 1 = high-risk (Label 2)
                     */
                    int predict(float *x) {
                        // Intercept (bias) term for class index 0 (low-risk)
                        float votes[2] = { 0.33220547072f, 0.0f };

                        // Dot product of feature vector with model coefficients
                        // Coefficient order matches FEATURES list in training script:
                        // [FSR1, FSR2, FSR3, FSR4, FSR5, FSR6,
                        //  FSR7, FSR8, FSR9, FSR10, FSR11, FSR12, TrunkAngle]
                        votes[0] += dot(x,
                             0.000200439079f,   // FSR1
                             0.000763401393f,   // FSR2
                             0.000499997715f,   // FSR3
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                             0.001127891752f,   // FSR12
                            -0.02811860066f     // TrunkAngle (dominant predictor)
                        );

                        // Return argmax → 0 (low-risk) or 1 (high-risk)
                        uint8_t classIdx = 0;
                        float   maxVotes = votes[0];
                        for (uint8_t i = 1; i < 2; i++) {
                            if (votes[i] > maxVotes) {
                                classIdx = i;
                                maxVotes = votes[i];
                            }
                        }
                        return classIdx;
                    }

                protected:
                    /**
                     * Compute dot product of feature vector x with variadic
                     * coefficient list. Expects exactly 13 coefficients.
                     */
                    float dot(float *x, ...) {
                        va_list w;
                        va_start(w, 13);
                        float result = 0.0f;
                        for (uint16_t i = 0; i < 13; i++) {
                            result += x[i] * (float)va_arg(w, double);
                        }
                        va_end(w);
                        return result;
                    }
            };

        }  // namespace Port
    }  // namespace ML
}  // namespace Eloquent
